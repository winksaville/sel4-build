## Kconfig
```kconfig
#
# Copyright 2014, Wink Saville
#
# This software may be distributed and modified according to the terms of
# the BSD 2-Clause license. Note that NO WARRANTY is provided.
# See "LICENSE_BSD2.txt" for details.

# This file defines the Kconfig menu structure.

mainmenu "Project Configuration"

config COMMON_PATH
    string
    option env="COMMON_PATH"

menu "seL4 Applications"
    source "apps/min-app/Kconfig"
    source "apps/helloworld/Kconfig"
    source "apps/assert/Kconfig"
    source "apps/myassert/Kconfig"
    source "apps/bootinfo/Kconfig"
    source "apps/test-nolibc/Kconfig"
endmenu

menu "seL4 Kernel"
    source "kernel/Kconfig"
endmenu

menu "seL4 Libraries"
    source "libs/libsel4/Kconfig"
    source "libs/libsel4putchar/Kconfig"
    source "libs/libsel4printf/Kconfig"
    source "libs/libsel4assert/Kconfig"
    source "libs/libsel4string/Kconfig"
    source "libs/libsel4startstop/Kconfig"
    source "libs/libsel4benchmark/Kconfig"
endmenu

source "$COMMON_PATH/Kconfig"
```
